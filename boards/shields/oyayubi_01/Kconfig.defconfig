## boards/shields/oyayubi_01/Kconfig.shield
```kconfig
config SHIELD_OYAYUBI_01_LEFT
    def_bool $(shields_list_contains,oyayubi_01_left)

config SHIELD_OYAYUBI_01_RIGHT
    def_bool $(shields_list_contains,oyayubi_01_right)
```
